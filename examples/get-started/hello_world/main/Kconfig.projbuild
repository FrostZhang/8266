## examples/get-started/hello_world/main/Kconfig.projbuild
```kconfig
menu "Example Configuration"

choice ESP_WIFI_MODE
    prompt "AP or STA"
    default ESP_WIFI_IS_STATION
    help
        Whether the esp32 is softAP or station.

config ESP_WIFI_IS_SOFTAP
    bool "SoftAP"
config ESP_WIFI_IS_STATION
    bool "Station"
endchoice

config ESP_WIFI_MODE_AP
    bool
    default y if ESP_WIFI_IS_SOFTAP
    default n if ESP_WIFI_IS_STATION

config ESP_WIFI_SSID
    string "WiFi SSID"
    default "myssid"
    help
	SSID (network name) for the example to connect to.

config ESP_WIFI_PASSWORD
    string "WiFi Password"
    default "mypassword"
    help
	WiFi password (WPA or WPA2) for the example to use.

config ESP_MQTT_ZZ
    string "MQTT ZZ"
    default "zz"
    help
	MQTT for the mqtt to connect to.

config ESP_MQTT_MM
    string "MQTT MM"
    default "mm"
    help
    MQTT for the mqtt to connect to.
		
config MAX_STA_CONN
    int "Max STA conn"
    default 4
    help
	Max number of the STA connects to AP.
    
config FIRMWARE_UPGRADE_URL
    string "firmware upgrade url endpoint"
    default "https://192.168.0.3:8070/hello-world.bin"
    help
        URL of server which hosts the firmware
        image.
endmenu
```

## examples/strip_4/main/Kconfig.projbuild
```kconfig
menu "strip_4 Configuration"

config ESP_WIFI_SSID
    string "WiFi SSID"
    default "myssid"
    help
	SSID (network name) for the example to connect to.

config ESP_WIFI_PASSWORD
    string "WiFi Password"
    default "mypassword"
    help
	WiFi password (WPA or WPA2) for the example to use.

config ESP_MQTT_ZZ
    string "MQTT ZZ"
    default "zz"
    help
	MQTT for the mqtt to connect to.

config ESP_MQTT_MM
    string "MQTT MM"
    default "mm"
    help
    MQTT for the mqtt to connect to.
    
config OTA_UPGRADE_URL
    string "OTA upgrade url endpoint"
    default "https://192.168.0.3:8070/hello-world.bin"
    help
        URL of server which hosts the firmware
        image.
endmenu
```
